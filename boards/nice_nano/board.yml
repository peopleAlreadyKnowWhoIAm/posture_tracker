## boards/nice_nano/board.yml
```yaml
board:
  name: nice_nano_v2
  full_name: Nice Nano V2
  vendor: nicekeyboards
  socs:
  - name: nrf52840
```

## boards/nice_nano/nice_nano_v2_defconfig
```kconfig
# SPDX-License-Identifier: MIT
# Enable MPU
CONFIG_ARM_MPU=y

# Use pinctrl
CONFIG_PINCTRL=y

# enable GPIO
CONFIG_GPIO=y

CONFIG_USE_DT_CODE_PARTITION=y
CONFIG_BUILD_OUTPUT_UF2=y

CONFIG_MPU_ALLOW_FLASH_WRITE=y
CONFIG_NVS=y
CONFIG_SETTINGS_NVS=y
CONFIG_FLASH=y
CONFIG_FLASH_PAGE_LAYOUT=y
CONFIG_FLASH_MAP=y

CONFIG_USB_DEVICE_STACK=y
CONFIG_USB_DEVICE_PRODUCT="Zephyr USB console sample"
CONFIG_USB_DEVICE_INITIALIZE_AT_BOOT=y
CONFIG_USB_DEVICE_VID=0x2FE3
CONFIG_USB_DEVICE_PID=0x1488

CONFIG_SERIAL=y
CONFIG_CONSOLE=y

CONFIG_UART_CONSOLE=y
CONFIG_UART_LINE_CTRL=y
CONFIG_LOG_BACKEND_UART=y 
```

## drivers/sensor/Kconfig
```kconfig
# Copyright (c) 2021 Nordic Semiconductor ASA
# SPDX-License-Identifier: Apache-2.0

if SENSOR
rsource "qmc5883l/Kconfig"
endif # SENSOR
```

## drivers/sensor/qmc5883l/Kconfig
```kconfig
menuconfig QMC5883L
	bool "QMC5883L magnetometer"
	default y
	depends on DT_HAS_QST_QMC5883L_ENABLED
	select I2C
	help
	  Enable driver for QMC5883L I2C-based magnetometer.
```

## dts/bindings/sensor/qst,qmc5883l.yaml
```yaml
description: |
  The QMC5883L is a 3-axis digital magnetometer from QST.
  It is used to measure the magnetic field in three dimensions.
  The device communicates over I2C and has a range of ±8 gauss.
  It is commonly used in applications such as compasses, navigation systems, and robotics.

  Example definition in devicetree:

    qmc5883l: qmc5883l@0d {
        compatible = "qst,qmc5883l";
        reg = <0x0d>;
        sampling-frequency = <100>;
        magnetic-field-range = <8>;
        oversampling = <64>;
    }

compatible: "qst,qmc5883l"

include: base.yaml

properties:
  sampling-frequency:
    type: int
    default: 100
    enum: [10,50, 100, 200]
    description: |
      The frequency at which the sensor samples data.
      The default value is 100 Hz.
  magnetic-field-range:
    type: int
    default: 2
    enum: [2, 8]
    description: |
      The range of the magnetic field that the sensor can measure.
      The default value is 2 gauss.
  oversampling:
    type: int
    default: 512
    enum: [64, 128, 256, 512]
    description: |
      The oversampling rate of the sensor.
      The default value is 512. 
      
```
